## boards/wch/ch32l103_evt/Kconfig.ch32l103_evt
```kconfig
# Copyright (c) 2026 Scott King
# SPDX-License-Identifier: Apache-2.0

config BOARD_CH32L103_EVT
	select SOC_CH32L103
```

## boards/wch/ch32l103_evt/ch32l103_evt_defconfig
```kconfig
CONFIG_CONSOLE=y
# CONFIG_SDI_CONSOLE is not set
CONFIG_UART_CONSOLE=y
CONFIG_SERIAL=y
CONFIG_GPIO=y
```

## drivers/adc/Kconfig.wch
```kconfig
# WCH ADC configuration options

config ADC_WCH
	bool "WCH ADC driver"
	default y
	depends on DT_HAS_WCH_ADC_ENABLED
	select PINCTRL
	help
	  Enable the WCH ADC driver.

config ADC_WCH_DMA
	bool "WCH ADC DMA support"
	depends on ADC_WCH
	select DMA
	help
	  Enable DMA support for the WCH ADC driver.

config ADC_WCH_TOUCHKEY
	bool "WCH CH32 Touchkey driver"
	default y
	depends on DT_HAS_WCH_CH32_TOUCHKEY_ENABLED
	select ADC_CONTEXT_NET_PKT_BUFFER
	help
	  Enable WCH CH32 Touchkey driver.
```

## drivers/comparator/Kconfig.wch
```kconfig
# WCH Comparator configuration options

config COMPARATOR_WCH
	bool "WCH Comparator driver"
	default y
	depends on DT_HAS_WCH_CMP_ENABLED
	help
	  Enable Comparator driver for WCH.
```

## drivers/crc/Kconfig.wch
```kconfig
# Copyright (c) 2026 Scott King
# SPDX-License-Identifier: Apache-2.0

config CRC_DRIVER_WCH
	bool "WCH CRC driver"
	depends on DT_HAS_WCH_CH32_CRC_ENABLED
	help
	  Enable support for the WCH CRC driver.
```

## drivers/mfd/Kconfig.wch_opacmp
```kconfig
# WCH OPACMP MFD configuration options

config MFD_WCH_OPACMP
	bool "WCH OPACMP MFD driver"
	default y
	depends on DT_HAS_WCH_OPACMP_ENABLED
	help
	  Enable MFD driver for WCH OPACMP peripheral.
```

## drivers/pinctrl/Kconfig.wch_ch32l103
```kconfig
# Copyright (c) 2026 Scott King
# SPDX-License-Identifier: Apache-2.0

config PINCTRL_WCH_CH32L103
	bool "WCH CH32L103 AFIO pin controller driver"
	default y
	depends on DT_HAS_WCH_CH32L103_AFIO_ENABLED
	help
	  Enable the WCH CH32L103 AFIO pin controller driver.
```

## drivers/pwm/Kconfig.wch
```kconfig
# Copyright (c) 2025 Michael Hope <michaelh@juju.nz>
# SPDX-License-Identifier: Apache-2.0

config PWM_WCH_GPTM
	bool "WCH General-purpose Timer (GPTM) for PWM"
	default y
	depends on DT_HAS_WCH_GPTM_PWM_ENABLED
	select PINCTRL
	help
	  PWM driver for the WCH GPTM, such as TIM2 on the CH32V003.

config PWM_WCH_LPTIM
	bool "WCH Low-power Timer (LPTIM) for PWM"
	default y
	depends on DT_HAS_WCH_CH32_LPTIM_PWM_ENABLED
	select PINCTRL
	help
	  PWM driver for the WCH LPTIM.
```

## drivers/timer/Kconfig.wch_lptim
```kconfig
# WCH LPTIM timer configuration options

# Copyright (c) 2026 Scott King
# SPDX-License-Identifier: Apache-2.0

config WCH_LPTIM_TIMER
	bool "WCH LPTIM timer"
	depends on DT_HAS_WCH_CH32_LPTIM_ENABLED
	select TICKLESS_CAPABLE
	help
	  Enables the WCH LPTIM timer as the system clock source.
	  Supports tickless kernel operation and can wake the system from sleep modes.

if WCH_LPTIM_TIMER

config WCH_LPTIM_CLOCK_SOURCE
	int "LPTIM clock source"
	default 3
	range 0 3
	help
	  Select the clock source for the LPTIM timer:
	  0: PCLK1 (APB1 bus clock) - highest frequency, doesn't run in sleep
	  1: HSI (8MHz internal oscillator) - medium power, fast wakeup
	  2: LSE (32.768kHz external crystal) - very low power, high accuracy
	  3: LSI (40kHz internal oscillator) - low power, medium accuracy, default

config WCH_LPTIM_PRESCALER
	int "LPTIM clock prescaler"
	default 1
	range 1 128
	help
	  Clock prescaler for the LPTIM timer. Valid values are 1, 2, 4, 8, 16, 32, 64, 128.
	  The effective timer clock is the source clock divided by this value.
	  Note: Only powers of 2 are valid. Other values will cause unpredictable behavior.

config WCH_LPTIM_TIMEOUT
	int "LPTIM timeout in seconds"
	default 1
	range 1 210
	help
	  Maximum timeout duration in seconds for the LPTIM timer.
	  With LSI (40kHz) and prescaler 1, max is ~1.6 seconds (0xFFFF/40000).
	  With prescaler 128, max is ~209 seconds.

config WCH_LPTIM_GUARD_VALUE
	int "LPTIM guard value (minimum cycles before ARR update)"
	default 5
	range 2 20
	help
	  Minimum number of timer cycles that must remain before the next
	  autoreload match before a new ARR value can be safely written.
	  A higher value reduces the risk of race conditions when updating
	  the autoreload register close to the match point, at the cost of
	  slightly reduced timeout precision. The default of 5 provides a
	  safe margin for most clock configurations. Increase this value
	  if you observe missed or spurious timer events.

endif # WCH_LPTIM_TIMER
```

## dts/bindings/adc/wch,ch32-touchkey.yaml
```yaml
# Copyright (c) 2026 Scott King
# SPDX-License-Identifier: Apache-2.0

description: |
  WCH CH32 Touchkey ADC

compatible: "wch,ch32-touchkey"

include: [adc-controller.yaml, pinctrl-device.yaml]

properties:
  reg:
    required: true

  clocks:
    required: true

  vref-mv:
    type: int
    default: 3300
    description: |
      Reference voltage in mV. This is typically VDD.

  pinctrl-0:
    required: true

  pinctrl-names:
    required: true

  "#io-channel-cells":
    const: 1

io-channel-cells:
  - input
```

## dts/bindings/clock/wch,ch32l103-pll-clock.yaml
```yaml
# Copyright (c) 2026 Scott King
# SPDX-License-Identifier: Apache-2.0

description: WCH CH32L103 PLL

compatible: "wch,ch32l103-pll-clock"

include: [clock-controller.yaml, base.yaml]

properties:
  "#clock-cells":
    const: 0

  clocks:
    type: phandle-array
    required: true

  mul:
    type: int
    required: true
    description: |
        Main PLL multiplication factor.
        For CH32L103, HSI is used directly (no /2 divider).
    enum:
      - 2
      - 3
      - 4
      - 5
      - 6
      - 7
      - 8
      - 9
      - 10
      - 11
      - 12
      - 13
      - 14
      - 15
      - 16
      - 17
      - 18
      - 19
      - 20
      - 21
      - 22
      - 23
      - 24
      - 25
      - 26
      - 27
      - 28
      - 29
      - 30
      - 31
      - 32
```

## dts/bindings/console/wch,sdi-wch.yaml
```yaml
# Copyright (c) 2026 Scott King
# SPDX-License-Identifier: Apache-2.0

description: WCH Serial Debug Interface (SDI) Console

compatible: "wch,sdi-wch"

include: base.yaml

properties:
  reg:
    required: true
    description: |
      Base address of the DMDATA0 register.
      For most QingKe cores (V2/V3/V4), this is 0xe0000380.
      For V003/X035 (partially), it might differ.
```

## dts/bindings/counter/wch,ch32-lptim-counter.yaml
```yaml
# Copyright (c) 2026 Scott King
# SPDX-License-Identifier: Apache-2.0

description: |
  WCH CH32 Low-Power Timer (LPTIM) used as a counter/alarm peripheral.

compatible: "wch,ch32-lptim-counter"

include: [base.yaml]

properties:
  reg:
    required: true

  interrupts:
    required: true

  clock-names:
    type: string-array
    required: true
    description: |
      Names of clocks. Should contain "lptim" for the timer bus clock
      and optionally a kernel clock.

  wch_clock_source:
    type: int
    default: 3
    description: |
      LPTIM clock source selection:
      0: PCLK1 (APB1 bus clock)
      1: HSI (8MHz internal oscillator)
      2: LSE (32.768kHz external crystal)
      3: LSI (40kHz internal oscillator, default)

  wch_prescaler:
    type: int
    default: 1
    description: |
      Clock prescaler. Valid values are 1, 2, 4, 8, 16, 32, 64, 128.
      The effective timer clock is the source clock divided by this value.

  status:
    type: string
    default: "disabled"
    description: |
      Status of the LPTIM device. Set to "okay" to enable.
```

## dts/bindings/opamp/wch,opa.yaml
```yaml
# Copyright (c) 2026 Scott King
# SPDX-License-Identifier: Apache-2.0

description: |
  WCH CH32 Operational Amplifier (OPA)

include: [base.yaml]

compatible: "wch,opa"

properties:
  reg:
    required: true

  wch_psel:
    type: int
    default: 0
    description: |
      Positive input selection for OPA.
      0: P0 (default)
      1: P1
      2: P2
      3: P3
      4: P4
      5: P5

  wch_nsel:
    type: int
    default: 0
    description: |
      Negative input selection for OPA.
      0: N0 (default)
      1: N1
      2: N2
      3: N3
      4: N4
      5: N5

  wch_mode:
    type: int
    default: 0
    description: |
      OPA mode.
      0: Power mode (default)
      1: Tour mode
      2: Power saving mode
```

## dts/bindings/timer/wch,ch32-lptim.yaml
```yaml
# Copyright (c) 2026 Scott King
# SPDX-License-Identifier: Apache-2.0

description: |
  WCH CH32 Low-Power Timer (LPTIM) used as system tick timer or counter.
  Supports tickless kernel operation and can wake the system from sleep modes.

compatible: "wch,ch32-lptim"

include: [base.yaml]

properties:
  reg:
    required: true

  interrupts:
    required: true

  clock-names:
    type: string-array
    required: true
    description: |
      Names of clocks. Should contain "lptim" for the timer bus clock
      and optionally a kernel clock.

  wch_clock_source:
    type: int
    default: 3
    description: |
      LPTIM clock source selection:
      0: PCLK1 (APB1 bus clock)
      1: HSI (8MHz internal oscillator)
      2: LSE (32.768kHz external crystal)
      3: LSI (40kHz internal oscillator, default)

  wch_prescaler:
    type: int
    default: 1
    description: |
      Clock prescaler. Valid values are 1, 2, 4, 8, 16, 32, 64, 128.
      The effective timer clock is the source clock divided by this value.

  wch_timeout:
    type: int
    default: 1
    description: |
      Maximum timeout in seconds. Used to calculate the LPTIM time base.
      With LSI (40kHz) and prescaler 1, max is ~1.6 seconds (0xFFFF/40000).
      With prescaler 128, max is ~209 seconds.

  status:
    type: string
    default: "disabled"
    description: |
      Status of the LPTIM device. Set to "okay" to enable.
```

## soc/wch/ch32v/qingke_v4c/Kconfig.defconfig.ch32l103
```kconfig
# Copyright (c) 2026 Scott King
# SPDX-License-Identifier: Apache-2.0

if SOC_CH32L103

config NUM_IRQS
	default 82

config VECTOR_TABLE_SIZE
	default 82

endif # SOC_CH32L103
```
